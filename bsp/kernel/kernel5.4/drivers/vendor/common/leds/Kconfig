## bsp/kernel/kernel5.4/drivers/vendor/common/leds/Kconfig
```kconfig
config ZTE_BREATHING_LIGHT_LEDS
	bool "ZTE_BREATHING_LIGHT_LEDS"
		depends on I2C
		default n
		help
		  Say Y here if you have zte breathing light leds chip.
		  If unsure, say N.

config ZTE_LEDS_AW210XX
	tristate "ZTE_LEDS_AW210XX"
		depends on I2C
		default n
		help
		  Say Y here if you have crypto breathing light leds chip aw210xx.
		  If unsure, say N.
```

## bsp/kernel/kernel5.4/drivers/vendor/common/power/Kconfig
```kconfig
menuconfig POWER_VENDOR_COMMON
	tristate "zte vendor common"
	default n
	help
	  Say Y here, if supported zte power policy

config VENDOR_ZTE_MISC
	tristate "zte misc module"
	depends on POWER_VENDOR_COMMON
	default n
	help
	  Say Y here to enable the "pmic voter module" driver

config VENDOR_POWER_VOTER
	tristate "pmic voter module"
	depends on POWER_VENDOR_COMMON
	default n
	help
	  Say Y here to enable the "pmic voter module" driver

config CHGING_WITH_VOTER
	tristate "charging setting use voter module"
	depends on VENDOR_POWER_VOTER
	default n
	help
	  Say Y here to enable the "charging setting use voter module" driver

config VENDOR_BATTERY_CAPACITY_LEARNING
	tristate "Battery Capacity Learning driver"
	depends on POWER_VENDOR_COMMON
	default n
	help
	  Say Y here to enable the "Battery Capacity Learning" driver

config VENDOR_CHARGE_ARBITRATE_SERVICE
	tristate "Charge Arbitrate Service Driver"
	depends on POWER_VENDOR_COMMON
	default n
	help
	  Say Y here to enable the "Charge Arbitrate Service" driver

config VENDOR_CHARGE_ARBITRATE_SERVICE_COMMON
	tristate "Charge Arbitrate Service Driver COMMON"
	depends on POWER_VENDOR_COMMON
	default n
	help
	  Say Y here to enable the "Charge Arbitrate Service Common" driver

config VENDOR_CHARGER_POLICY_SERVICE
	tristate "Charger Policy Service Driver"
	depends on POWER_VENDOR_COMMON && VENDOR_ZTE_MISC
	default n
	help
	  Say Y here to enable the "Charger Policy Service" driver

config VENDOR_CPU_RATE_CTRL
	tristate "use cpu rate ctrl charging current"
	depends on POWER_VENDOR_COMMON && VENDOR_ZTE_MISC
	default n
	help
	  Say Y here to enable the "Charger Policy Service" driver

config VENDOR_MTK_FG_RES_2MO
	tristate "Control the sampling resistor of the mtk fuel gauge using 2 milliohms"
	default n
	help
	  Say Y here to enable the "mtk fuel gauge using 2 milliohms" driver
```

## bsp/kernel/kernel5.4/drivers/vendor/common/touchscreen/Kconfig
```kconfig
#
# Touchscreen driver configuration
#
menuconfig TOUCHSCREEN_VENDOR
	tristate "Touchscreens"
	default n
	help
	  Say Y here, and a list of supported touchscreens will be displayed.
	  This option doesn't affect the kernel.

	  If unsure, say n.

if TOUCHSCREEN_VENDOR

source "drivers/vendor/common/touchscreen/hxchipset_v2/Kconfig"
source "drivers/vendor/common/touchscreen/hxchipset_v3/Kconfig"
source "drivers/vendor/common/touchscreen/chipone_tddi/Kconfig"
source "drivers/vendor/common/touchscreen/ilitek_tddi_9881x/Kconfig"
source "drivers/vendor/common/touchscreen/tlsc6x_v3/Kconfig"
source "drivers/vendor/common/touchscreen/NVT_Touch_HostDL/Kconfig"
source "drivers/vendor/common/touchscreen/gcore_ts/Kconfig"
source "drivers/vendor/common/touchscreen/goodix_berlin_driver_v2/Kconfig"
source "drivers/vendor/common/touchscreen/omnivision_tcm/Kconfig"
source "drivers/vendor/common/touchscreen/chipone_tddi_v2/Kconfig"
source "drivers/vendor/common/touchscreen/chipone_tddi_v3/Kconfig"
source "drivers/vendor/common/touchscreen/focaltech_touch_V3_3/Kconfig"

config TS_FIRMWARE
	string "config board firmware folder"

config TP_BSC_CALIBRATION
        bool "tp bsc calibration, synaptics_tcm driver need this node"
		default n
		help
		This enables tp bsc calibration.

config TP_DETECT_BY_LCDINFO
        bool "tp ic detected by lcd information"
		default n
		help
		This enables support for tp ic detected by lcd information.

config DRM_PANEL_NOTIFIER
	bool "add qcom drm panel support"
	default n
	help
	  Say Y here to enable debug tools.

	  If unsure, say N.

config TPD_UFP_MAC
	bool "tp under fingerprint status machine"
	default n
	help
	  Say Y here if you want to have a under fingerprint status machine
	  If unsure, say N.
config SCREEN_ON_TEMP_SUPPORT
	bool "lcd has a temp on when off to aod"
	depends on TPD_UFP_MAC
	default n
	help
		Say y here if your lcd has a temp on when off to aod
		if unsure, say n.
config JITTER_PIXEL
	int "set touch jitter pixel restriction"
	range 0 30
	default 0
	help
	  if set JITTER_PIXEL,  the second point can be report only when move more than JITTER_PIXEL pixels.
config USER_HAL_READ_FW
	bool "tp firmware upgrade user tp_fw_upgrade upgrade firmware"
	default n
	help
	  Say Y here if you want to user tp_fw_upgrade upgrade firmware
	  If unsure, say N.
config GET_NOISE_USER_BIG_BUFFER
	bool "get tp noise user big buffer"
	default n
	help
	  Say Y here if you want to get tp noise user big buffer
	  If unsure, say N.

config TS_POINT_REPORT_CHECK
	bool "all point clean when tp irq timeout"
	default n
	help
	  Say Y here to enable .
	  If unsure, say N.

endif
```

## bsp/kernel/kernel5.4/drivers/vendor/common/touchscreen_v2/Kconfig
```kconfig
#
# Touchscreen driver configuration
#
config TOUCHSCREEN_VENDOR_V2
	tristate "Touchscreens"
	default n
	help
	  Say Y here, and a list of supported touchscreens will be displayed.
	  This option doesn't affect the kernel.

	  If unsure, say n.

if TOUCHSCREEN_VENDOR_V2

source "drivers/vendor/common/touchscreen_v2/goodix_berlin_driver_v2/Kconfig"
source "drivers/vendor/common/touchscreen_v2/chipone_tddi_v3/Kconfig"
source "drivers/vendor/common/touchscreen_v2/chsc5xxx/Kconfig"
source "drivers/vendor/common/touchscreen_v2/ilitek_tddi_v3/Kconfig"

config TOUCHSCREEN_BOARD_NAME
	string "config board firmware folder"

config TOUCHSCREEN_DRM_PANEL_NOTIFIER
	bool "add qcom drm panel support"
	default n
	help
	  Say Y here to enable debug tools.

	  If unsure, say N.

config TOUCHSCREEN_UFP_MAC
	bool "tp under fingerprint status machine"
	default n
	help
	  Say Y here if you want to have a under fingerprint status machine
	  If unsure, say N.

config TOUCHSCREEN_POINT_REPORT_CHECK
	bool "all point clean when tp irq timeout"
	default n
	help
	  Say Y here to enable .
	  If unsure, say N.
config TOUCHSCREEN_POINT_SIMULAT_UF
 	bool "tp under fingerprint status machine"
 	default n
 	help
 	  Say Y here if you want to simulate finger down
 	  If unsure, say N.
endif
```

## bsp/kernel/kernel5.4/drivers/vendor/common/zlog/Kconfig
```kconfig
menuconfig VENDOR_ZTE_LOG_EXCEPTION
	bool "zte log exception"
	default n
	help
	  Say Y here, if supported zte log exception
```
