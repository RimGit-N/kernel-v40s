## bsp/kernel/kernel5.4/drivers/vendor/common/sensor/sar/Kconfig
```kconfig
config SAR_SENSOR_AW9610X
	bool "SAR_SENSOR_AW9610X"
		depends on I2C
		default n
		help
		  Say Y here if you have aw9610x sar sensor.
		  If unsure, say N.
```

## bsp/kernel/kernel5.4/drivers/vendor/common/touchscreen/sitronix_ts/Kconfig
```kconfig
#
# sitronix Touchscreen driver configuration
#

config TOUCHSCREEN_SITRONIX_TS
    bool "sitronix Touchscreen"
    depends on I2C
    default n
    help
      Say Y here if you have sitronix touch panel.
      If unsure, say N.
```
