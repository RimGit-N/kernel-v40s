
#include "zte_lcd_visionox_sd5302_hbm51_6p67_amoled_fhd_cmd_newotp.dtsi"

#include "zte_lcd_dummy_mipi.dtsi"

&dphy {
	/delete-property/ sprd,ulps-disabled;
};

/*
&i2c4 {
	ti65132b@3e {
		compatible = "tps,ti65132b";
		reg = <0x3e>;
		zte,lcd-bl-vsp-vsn-enhance-enable;
		zte,tps65132b_enhance_value = <0xffff>;
	};
};
*/

&dpu_qos {
	arqos-high = [0f];
};

&panel {
	reset-gpio = <&ap_gpio 50 GPIO_ACTIVE_HIGH>;
	avdd-gpio = <&ap_gpio 96 GPIO_ACTIVE_HIGH>;
	avee-gpio = <&ap_gpio 62 GPIO_ACTIVE_HIGH>;
};
