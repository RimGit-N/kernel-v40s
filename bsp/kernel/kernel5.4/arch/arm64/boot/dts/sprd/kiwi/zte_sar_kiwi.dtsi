&i2c4 {
	status = "okay";
	aw9610x_sar@12 {
		compatible = "awinic,aw9610x_sar";
		reg = <0x12>;
		irq-gpio = <&ap_gpio 61 0>;
		chip_name = "AW96103";
		sar_scan_time = < 1000 >;
		status = "okay";
	};
};

