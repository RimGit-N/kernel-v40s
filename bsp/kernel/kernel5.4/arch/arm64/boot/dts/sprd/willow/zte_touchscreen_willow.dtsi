&spi3 {
	status = "ok";
	#address-cells = <1>;
	#size-cells = <0>;
	zte-ts@0 {
		compatible = "tchip,ilitek";
		reg = <0>;
		spi-max-frequency = <9600000>;
 		touch,irq-gpio = <&ap_gpio 144 0x2008>; /* IRQF_ONESHOT | IRQF_TRIGGER_LOW */
 		touch,reset-gpio = <&ap_gpio 145 0x0000>;
 	};
 };
 